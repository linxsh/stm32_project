## Kconfig
```kconfig
# Author: linxsh
# Kconfig: Top Level Kconfig
#---------------------------------------------------------------------------------#
#
mainmenu "Configuration"

#---------------------------------------------------------------------------------#
#
menu "Develop Board Config"

config BOARD
	prompt "Board (STM32F100 STM32F107)"
	string
	default "STM32F100" 

endmenu

#---------------------------------------------------------------------------------#
#
menu "Operating System Support"

source os/Kconfig

endmenu

#---------------------------------------------------------------------------------#
#
```

## os/Kconfig
```kconfig
# Author: linxsh
# Kconfig: Operating system Kconfig
#---------------------------------------------------------------------------------#
#
#

menuconfig RTOS
	bool "RTOS"
	help
		Say Y or N to enable RTOS.This is real time operation system.
source os/rtos/Kconfig

menuconfig UCOS
	bool "UCOS"
	help
		Say Y or N to enable UCOS.This is u control operation system.
source os/ucos/Kconfig
```

## os/rtos/Kconfig
```kconfig
menuconfig NET
	tristate "Network Support"
	depends on RTOS

config TCP
	bool "Transmission Control Protocol"
	depends on NET

config UDP
	bool "User Datagram Protocol"
	depends on NET
```
